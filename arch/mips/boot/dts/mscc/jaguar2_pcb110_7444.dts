// SPDX-License-Identifier: (GPL-2.0+ OR MIT)
/*
 * Copyright (c) 2020 Microchip Corporation
 */

/dts-v1/;
#include "jaguar2_pcb110.dtsi"

/ {
    meba {
        board = "SparX-IV_44";
        type = "2";
        port_cfg = "2";
        target = "0x7444";
        family = "jaguar2";

    };
};
