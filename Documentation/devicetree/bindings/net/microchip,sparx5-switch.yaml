## Documentation/devicetree/bindings/net/microchip,sparx5-switch.yaml
```yaml
# SPDX-License-Identifier: GPL-2.0-only OR BSD-2-Clause
%YAML 1.2
---
$id: http://devicetree.org/schemas/net/microchip,sparx5-switch.yaml#
$schema: http://devicetree.org/meta-schemas/core.yaml#

title: Microchip Sparx5 Ethernet switch controller

maintainers:
  - Lars Povlsen <lars.povlsen@microchip.com>
  - Steen Hegelund <steen.hegelund@microchip.com>

description: |
  The SparX-5 Enterprise Ethernet switch family provides a rich set of
  Enterprise switching features such as advanced TCAM-based VLAN and
  QoS processing enabling delivery of differentiated services, and
  security through TCAM-based frame processing using versatile content
  aware processor (VCAP).

  IPv4/IPv6 Layer 3 (L3) unicast and multicast routing is supported
  with up to 18K IPv4/9K IPv6 unicast LPM entries and up to 9K IPv4/3K
  IPv6 (S,G) multicast groups.

  L3 security features include source guard and reverse path
  forwarding (uRPF) tasks. Additional L3 features include VRF-Lite and
  IP tunnels (IP over GRE/IP).

  The SparX-5 switch family targets managed Layer 2 and Layer 3
  equipment in SMB, SME, and Enterprise where high port count
  1G/2.5G/5G/10G switching with 10G/25G aggregation links is required.

properties:
  $nodename:
    pattern: "^switch@[0-9a-f]+$"

  compatible:
    const: microchip,sparx5-switch

  reg:
    minItems: 2

  reg-names:
    items:
      - const: devices
      - const: gcb

  interrupts:
    maxItems: 1
    description: Interrupt used for reception of packets to the CPU

  mac-address:
    maxItems: 1
    description:
      Specifies the MAC address that is used as the template for the MAC
      addresses assigned to the ports provided by the driver.  If not provided
      a randomly generated MAC address will be used.

  ethernet-ports:
    type: object
    properties:
      '#address-cells':
        const: 1
      '#size-cells':
        const: 0

    patternProperties:
      "^port@[0-9]+$":
        type: object
        description: Switch ports

        allOf:
          - $ref: ethernet-controller.yaml#

        properties:
          reg:
            description: Switch port number

          bandwidth:
            maxItems: 1
            $ref: /schemas/types.yaml#definitions/uint32
            description: Specifies bandwidth in Mbit/s allocated to the port.

          phys:
            maxItems: 1
            description:
              phandle of a Ethernet SerDes PHY.  This defines which SerDes
              instance will handle the Ethernet traffic.

          phy-handle:
            maxItems: 1
            description:
               phandle of a Ethernet PHY.  This is optional and if provided it
               points to the cuPHY used by the Ethernet SerDes.

          phy-mode:
            maxItems: 1
            description:
              This specifies the interface used by the Ethernet SerDes towards the
              phy or SFP.

          sfp:
            maxItems: 1
            description:
              phandle of an SFP.  This is optional and used when not specifying
              a cuPHY.  It points to the SFP node that describes the SFP used by
              the Ethernet SerDes.

          managed:
            maxItems: 1
            description:
              SFP management. This must be provided when specifying an SFP.

          sd_sgpio:
            $ref: /schemas/types.yaml#/definitions/uint32
            maxItems: 1
            description:
              Index of the ports Signal Detect SGPIO in the set of 384 SGPIOs
              This is optional, and only needed if the default used index is
              is not correct.

        required:
          - reg
          - bandwidth
          - phys
          - phy-mode

        oneOf:
          - required:
              - phy-handle
          - required:
              - sfp
              - managed

        additionalProperties: false

required:
  - compatible
  - reg
  - reg-names
  - interrupts
  - ethernet-ports

additionalProperties: false

examples:
  - |
    #include <dt-bindings/interrupt-controller/arm-gic.h>
    switch: switch@600000000 {
      compatible = "microchip,sparx5-switch";
      reg =  <0x10000000 0x800000>,
             <0x11010000 0x1b00000>;
      reg-names = "devices", "gcb";

      interrupts = <GIC_SPI 30 IRQ_TYPE_LEVEL_HIGH>;
      ethernet-ports {
        #address-cells = <1>;
        #size-cells = <0>;

        port0: port@0 {
          reg = <0>;
          bandwidth = <1000>;
          phys = <&serdes 13>;
          phy-handle = <&phy0>;
          phy-mode = "qsgmii";
        };
        /* ... */
        /* Then the 25G interfaces */
        port60: port@60 {
          reg = <60>;
          bandwidth = <25000>;
          phys = <&serdes 29>;
          phy-mode = "10gbase-r";
          sfp = <&sfp_eth60>;
          managed = "in-band-status";
        };
        port61: port@61 {
          reg = <61>;
          bandwidth = <25000>;
          phys = <&serdes 30>;
          phy-mode = "10gbase-r";
          sfp = <&sfp_eth61>;
          managed = "in-band-status";
        };
        port62: port@62 {
          reg = <62>;
          bandwidth = <25000>;
          phys = <&serdes 31>;
          phy-mode = "10gbase-r";
          sfp = <&sfp_eth62>;
          managed = "in-band-status";
        };
        port63: port@63 {
          reg = <63>;
          bandwidth = <25000>;
          phys = <&serdes 32>;
          phy-mode = "10gbase-r";
          sfp = <&sfp_eth63>;
          managed = "in-band-status";
        };
        /* Finally the Management interface */
        port64: port@64 {
          reg = <64>;
          bandwidth = <1000>;
          phys = <&serdes 0>;
          phy-handle = <&phy64>;
          phy-mode = "sgmii";
        };
      };
    };

...
```

## Documentation/devicetree/bindings/pinctrl/microchip,sparx5-sgpio.yaml
```yaml
# SPDX-License-Identifier: GPL-2.0-only OR BSD-2-Clause
%YAML 1.2
---
$id: http://devicetree.org/schemas/pinctrl/microchip,sparx5-sgpio.yaml#
$schema: http://devicetree.org/meta-schemas/core.yaml#

title: Microsemi Serial GPIO controller

maintainers:
  - Lars Povlsen <lars.povlsen@microchip.com>

description: |
  By using a serial interface, the SIO controller significantly extend
  the number of available GPIOs with a minimum number of additional
  pins on the device. The primary purpose of the SIO controllers is to
  connect control signals from SFP modules and to act as an LED
  controller.

properties:
  $nodename:
    pattern: "gpio"

  compatible:
    enum:
      - microchip,sparx5-sgpio
      - mscc,ocelot-sgpio
      - mscc,luton-sgpio

  clocks:
    maxItems: 1

  gpio-controller: true

  '#gpio-cells':
    description: GPIO consumers must specify four arguments, first the
      port number, then the bit number, then a input/output flag and
      finally the GPIO flags (from include/dt-bindings/gpio/gpio.h).
      The dt-bindings/gpio/mchp-sgpio.h file define manifest constants
      PIN_INPUT and PIN_OUTPUT.
    const: 4

  gpio-ranges:
    maxItems: 1

  microchip,sgpio-port-ranges:
    description: This is a sequence of tuples, defining intervals of
      enabled ports in the serial input stream. The enabled ports must
      match the hardware configuration in order for signals to be
      properly written/read to/from the controller holding
      registers. Being tuples, then number of arguments must be
      even. The tuples mast be ordered (low, high) and are
      inclusive. Arguments must be between 0 and 31.
    $ref: /schemas/types.yaml#/definitions/uint32-array
    minItems: 2
    maxItems: 64

  microchip,sgpio-frequency:
    description: The sgpio controller frequency (Hz). This dictates
      the serial bitstream speed, which again affects the latency in
      getting control signals back and forth between external shift
      registers. The speed must be no larger than half the system
      clock, and larger than zero.
    $ref: /schemas/types.yaml#/definitions/uint32
    minimum: 1
    default: 12500000

required:
  - compatible
  - clocks
  - gpio-controller
  - '#gpio-cells'
  - gpio-ranges
  - microchip,sgpio-port-ranges

examples:
  - |
    sgpio2: gpio@1101036c {
        compatible = "microchip,sparx5-sgpio";
        pinctrl-0 = <&sgpio0_pins>;
        pinctrl-names = "default";
        reg = <0x1101036c 0x100>;
        clocks = <&sys_clk>;
        gpio-controller;
        gpio-ranges = <&sgpio0 0 0 192>;
        #gpio-cells = <4>;
        microchip,sgpio-port-ranges = <0 0 16 18 28 31>;
        microchip,sgpio-frequency = <25000000>;
    };
```

## Documentation/devicetree/bindings/power/reset/ocelot-reset.txt
```
Microsemi Ocelot reset controller

The DEVCPU_GCB:CHIP_REGS have a SOFT_RST register that can be used to reset the
SoC core.

The reset registers are both present in the MSCC vcoreiii MIPS and
microchip Sparx5 armv8 SoC's.

Required Properties:
 - compatible: "mscc,ocelot-chip-reset" or "microchip,sparx5-chip-reset"

Optional properties:
- microchip,reset-switch-core : Perform a switch core reset at the
  time of driver load. This is may be used to initialize the switch
  core to a known state (before other drivers are loaded).

Example:
	reset@1070008 {
		compatible = "mscc,ocelot-chip-reset";
		reg = <0x1070008 0x4>;
		microchip,reset-switch-core;
	};
```

## Documentation/devicetree/bindings/reset/microchip,rst.yaml
```yaml
# SPDX-License-Identifier: (GPL-2.0-only OR BSD-2-Clause)
%YAML 1.2
---
$id: "http://devicetree.org/schemas/reset/microchip,rst.yaml#"
$schema: "http://devicetree.org/meta-schemas/core.yaml#"

title: Microchip Sparx5 Switch Reset Controller

maintainers:
  - Steen Hegelund <steen.hegelund@microchip.com>
  - Lars Povlsen <lars.povlsen@microchip.com>

description: |
  The Microchip Sparx5 Switch provides reset control and implements the following
  functions
    - One Time Switch Core Reset (Soft Reset)

properties:
  $nodename:
    pattern: "^reset-controller@[0-9a-f]+$"

  compatible:
    const: microchip,sparx5-switch-reset

  reg:
    minItems: 2
    description: register ranges used to access CPU reset and Global Control Block

  reg-names: true

  "#reset-cells":
    const: 1

required:
  - compatible
  - reg
  - reg-names
  - "#reset-cells"

additionalProperties: false

examples:
  - |
    reset: reset-controller@0 {
        compatible = "microchip,sparx5-switch-reset";
        #reset-cells = <1>;
        reg = <0x0 0xd0>,
              <0x11010000 0x10000>;
        reg-names = "cpu", "gcb";
    };
```

## Documentation/devicetree/bindings/thermal/microchip,sparx5-temp.txt
```
* Microchip Sparx5 Thermal Sensor

This binding describes thermal sensors that is part of Sparx5 SoCs.

Required properties:
- compatible : Must be "microchip,sparx5-temp"
- reg : Address of the temperature sensor registers
- #thermal-sensor-cells : must be 0

Example:

	tmon0: tmon@610508110 {
		compatible = "microchip,sparx5-temp";
		reg = <0x6 0x10508110 0xc>;
		#thermal-sensor-cells = <0>;
	};
```

## Documentation/devicetree/bindings/thermal/mscc,fa-temp.txt
```
* Microchip Fireant Thermal Sensor

This binding describes thermal sensors that is part of Fireant SoCs.

Required properties:
- compatible : Must be "mscc,fa-temp"
- reg : Address of the temperature sensor registers
- #thermal-sensor-cells : must be 0

Example:

	tmon0: tmon@610508110 {
		compatible = "mscc,fa-temp";
		reg = <6 0x10508110 0xc>;
		#thermal-sensor-cells = <0>;
	};
```

## arch/arm64/configs/fireant_defconfig
```kconfig
# CONFIG_SWAP is not set
CONFIG_BLK_DEV_INITRD=y
CONFIG_CC_OPTIMIZE_FOR_SIZE=y
# CONFIG_SHMEM is not set
CONFIG_EMBEDDED=y
CONFIG_ARCH_FIREANT=y
CONFIG_ARCH_VEXPRESS=y
CONFIG_NR_CPUS=2
CONFIG_BINFMT_MISC=y
CONFIG_DEVTMPFS=y
CONFIG_DEVTMPFS_MOUNT=y
CONFIG_MTD=y
CONFIG_MTD_CMDLINE_PARTS=y
CONFIG_MTD_BLOCK=y
CONFIG_MTD_M25P80=y
CONFIG_MTD_SPI_NOR=y
# CONFIG_MTD_SPI_NOR_USE_4K_SECTORS is not set
CONFIG_MTD_UBI=y
CONFIG_BLK_DEV_LOOP=y
CONFIG_BLK_DEV_RAM=y
CONFIG_BLK_DEV_RAM_COUNT=2
CONFIG_BLK_DEV_RAM_SIZE=16384
# CONFIG_INPUT_KEYBOARD is not set
# CONFIG_INPUT_MOUSE is not set
# CONFIG_SERIO is not set
# CONFIG_VT is not set
CONFIG_SERIAL_8250=y
CONFIG_SERIAL_8250_CONSOLE=y
CONFIG_SERIAL_8250_NR_UARTS=2
CONFIG_SERIAL_8250_RUNTIME_UARTS=2
CONFIG_SERIAL_OF_PLATFORM=y
CONFIG_SERIAL_AMBA_PL011=y
CONFIG_SERIAL_AMBA_PL011_CONSOLE=y
CONFIG_SPI=y
CONFIG_SPI_DESIGNWARE=y
CONFIG_SPI_DW_MMIO=y
CONFIG_SPI_SPIDEV=y
CONFIG_PINCTRL_OCELOT=y
# CONFIG_USB_SUPPORT is not set
CONFIG_UIO=y
CONFIG_UIO_PDRV_GENIRQ=y
CONFIG_OVERLAY_FS=y
CONFIG_UBIFS_FS=y
# CONFIG_UBIFS_FS_XATTR is not set
CONFIG_SQUASHFS=y
CONFIG_SQUASHFS_XZ=y
CONFIG_PRINTK_TIME=y
CONFIG_DEBUG_INFO=y
CONFIG_DEBUG_FS=y
CONFIG_MAGIC_SYSRQ=y
CONFIG_PANIC_ON_OOPS=y
CONFIG_PANIC_TIMEOUT=1
```
